## .defconfig
```kconfig
CONFIG_ARCH_X86=y
# CONFIG_ARCH_ARM32 is not set
# CONFIG_ARCH_RISCV is not set

#
# x86 architecture
#
# CONFIG_ARCH_CPU_386 is not set
CONFIG_ARCH_CPU_486=y
# CONFIG_ARCH_CPU_P5 is not set
# CONFIG_ARCH_CPU_P6 is not set
CONFIG_ARCH_HW_PC=y

#
# CPU Features
#

#
# Paging
#
CONFIG_X86_PAGING_KERNEL_WP=y
# end of Paging

# CONFIG_X86_APIC is not set
# end of CPU Features

CONFIG_MULTIBOOT=y
CONFIG_MULTIBOOT_VERSION=2
# end of x86 architecture

CONFIG_LOG_COLORCODE=y
# CONFIG_EMBEDDED_INITRD is not set
CONFIG_SAFETY_CHECKS=y
CONFIG_STRICTNESS=255

#
# Processes and threads
#
CONFIG_PROC_KERN_STACK_SIZE=4096
CONFIG_PROC_USER_STACK_SIZE=32768
CONFIG_PROC_USER_STACK_SIZE_MAX=65536
# CONFIG_PROC_STACK_GUARD is not set
# CONFIG_KTASK_DEBUGGER is not set
# end of Processes and threads

#
# General build options
#
CONFIG_BUILD_USE_WERROR=y
# CONFIG_BUILD_USE_CLANG is not set
# end of General build options
```

## Kconfig
```kconfig
mainmenu "Lambda Kernel Configuration"

source "kernel/Kconfig"

menu "General build options"

config BUILD_USE_WERROR
    bool "Enable -Werror"
    default y
    help
      Passes the -Werror flag to the compiler, treating any warning as an error.
      This should typically be enabled, except during active development, as
      builds should be warning-free.

config BUILD_USE_CLANG
    bool "Use Clang as the compiler"
    default n
    help
      Configures the build system to use Clang rather than GCC (or compatible)
      as the compiler. Note that this may not be well-supported for all targets.

config BUILD_USE_WEVERYTHING
    bool "Enable -Weverything"
    depends on BUILD_USE_CLANG
    default n
    help
      Passes the -Weverything flag to Clang, enabling many more warnings. Note
      that some warnings are explicitly disabled while this is enabled. Do not
      expect -Weverything + -Werror to succeed after a Clang update.

endmenu # General build options
```

## kernel/arch/Kconfig
```kconfig
# Architecture config

choice
    prompt "Target arhitecture"
    default ARCH_X86

config ARCH_X86
    bool "X86 (32-bit)"

config ARCH_ARM32
    bool "ARM (32-bit)"

config ARCH_RISCV
    bool "RISCV (32-bit)"

endchoice # Target architecture

source "kernel/arch/x86/Kconfig"
source "kernel/arch/arm32/Kconfig"
source "kernel/arch/riscv/Kconfig"
```

## kernel/arch/arm32/Kconfig
```kconfig
menu "ARM32 architecture"
    depends on ARCH_ARM32

choice
    prompt "CPU family"

config ARCH_CPU_CORTEX_A7
    bool "Cortex A7"

config ARCH_CPU_CORTEX_A9
    bool "Cortex A9"

config ARCH_CPU_CORTEX_A53
    bool "Cortex A53"

endchoice # CPU family

choice
    prompt "Hardware platform"

config ARCH_HW_ARM_VEXPRESS_A9
    bool "ARM Versatile Express A9"
    select ARCH_CPU_CORTEX_A9

config ARCH_HW_ALLWINNER_V3S
    bool "Allwinner V3s (unsupported)"
    select ARCH_CPU_CORTEX_A7

config ARCH_HW_BROADCOM_BCM2837
    bool "Broadcom BCM2837"
    select ARCH_CPU_CORTEX_A53

endchoice # Hardware platform

endmenu # ARM32 architecture
```

## kernel/arch/riscv/Kconfig
```kconfig
menu "RISC-V architecture"
    depends on ARCH_RISCV

choice
    prompt "CPU family"

config ARCH_CPU_RV64I
    prompt "RISC-V RV64I"

endchoice # CPU family

choice
    prompt "Hardware platform"

config ARCH_HW_KENDRYTE_K210
    bool "Kendryte k210"
    select ARCH_CPU_RV64I

endchoice # Hardware platform

endmenu # RISC-V architecture
```

## kernel/arch/x86/Kconfig
```kconfig
menu "x86 architecture"
    depends on ARCH_X86

choice
    prompt "CPU family"
    default ARCH_CPU_486
    help
      CPU family/architecture to support. This will automatically select
      features supported by the target. Note that currently, the kernel does not
      use CPUID to determine support at runtime, so a CPU at or below the desired
      target must be chosen to reliably operate on a given machine.

config ARCH_CPU_386
    bool "i386"

config ARCH_CPU_486
    bool "i486"

config ARCH_CPU_P5
    bool "Pentium/P5"

config ARCH_CPU_P6
    bool "Pentium Pro/P6"

endchoice # CPU family

choice
    prompt "Hardware target"

config ARCH_HW_PC
    bool "PC"

endchoice # Hardware target


menu "CPU Features"

menu "Paging"

config X86_PAGING_GLOBAL_PAGES
    bool "Global page support"
    depends on !ARCH_CPU_386 && !ARCH_CPU_486
    default y

config X86_PAGING_KERNEL_WP
    bool "Enable write-protect support while in kernel mode"
    default y

endmenu # Paging

menuconfig X86_APIC
    bool "APIC (Advanced Programmable Interrupt Controller) Support"
    depends on !ARCH_CPU_386
    default y if !ARCH_CPU_486

if X86_APIC

config X86_APIC_TIMER
    bool "APIC timer support (experimental)"
    default n

endif # X86_APIC

endmenu # CPU Features


config MULTIBOOT
    bool "Enable Multiboot support (do not disable)"
    default y
    help
      Enables Multiboot support for the kernel. Currently, this is the only
      supported boot method, so it must remain enabled.

config MULTIBOOT_VERSION
    int "Select Multiboot version"
    range 1 2
    default 2
    help
      Select Multiboot speicification version to use. Note that LBoot only
      supports version 2.

endmenu # x86 Architecture Config
```

## kernel/src/Kconfig
```kconfig
# Common kernel configuration

config LOG_COLORCODE
    bool "Color-code kernel log output"

config EMBEDDED_INITRD
    bool "Embeded initrd into kernel image"

config EMBEDDED_INITRD_LZOP
    bool "Use LZO1X compression for embedded initrd"
    depends on EMBEDDED_INITRD

config SAFETY_CHECKS
    bool "Enable runtime data checks"
    default y
    help
      Enables checks for input/data validity within the kernel, including data
      that comes from userspace. This causes some overhead for kernel calls and
      other operations. Disabling this is a huge security risk, and should only
      be done if you know what you are doing.

      This is an older config and may one day be merged with STRICTNESS, or a
      similar config.

config STRICTNESS
    int "Kernel strictness level"
    range 0 255
    default 255
    help
      How strictly the kernel should monitor data and parameters. Setting this
      to 0 creates a security risk, as validation of userland input is not
      checked. See SAFETY_CHECKS for details. It is useful to set this to a
      higher level during development to catch bugs.

      Levels:
       0: Disable all checks
       1: Enable checking of data passed in from userland
       2: Enable additional checks where performance impact is negligible
       3: Enable additional checks where performance impact is low
       4: Enable additional checks where performance impact is moderate
       5: Enable additional checks where performance impact is high
       255: Enable all checks

source "kernel/src/crypto/Kconfig"
source "kernel/src/proc/Kconfig"
```

## kernel/src/crypto/Kconfig
```kconfig
menuconfig CRYPTO
    bool "Crypto support"
    default y
    help
        Cryptogrophy support, includes compression/decompression support

if CRYPTO

menuconfig CRYPTO_COMP
    bool "Compression/decompression support"
    default y
    help
        Enable support for compression and decompression in the kernel


if CRYPTO_COMP

config CRYPTO_COMP_LZOP
    bool "LZOP support"
    default y
    help
        Enable support for LZOP compressed file format, decompression only

endif # CRYPTO_COMP

endif # CRYPTO
```

## kernel/src/proc/Kconfig
```kconfig
menu "Processes and threads"

config PROC_KERN_STACK_SIZE
    int "Kernel stack size"
    range 2048 65536
    default 4096
    help
      Stack size to use for kernel stacks

config PROC_USER_STACK_SIZE
    int "Default user stack size"
    range 2048 1048576
    default 32768
    help
      Default stack size to allocate for a userspace thread if none is specified

config PROC_USER_STACK_SIZE_MAX
    int "Maximum user stack size"
    range 4096 1048576
    default 65536
    help
      Maximum size of a user thread stack, this is the size used to separate
      thread stacks from eachother (plus two page sizes, if PROC_STACK_GUARD is
      enabled). Must be greater than or equal to PROC_USER_STACK_SIZE

config PROC_STACK_GUARD
    bool "Enable stack guard (experimental)"
    default n
    help
      This enables guards at the beginning and end of the stack, each being one
      page large. With the current (naive) implementation, this will increase
      the memory utilization of each stack by two page sizes (currently only K).
      If a thread attempts to read or write beyond the stack, it will trigger a
      page fault.

      Not all targets support this feature.

config KTASK_DEBUGGER
    bool "Enable debugger ktask"
    default n
    help
      Enables the debugger ktak. Note that this is not well-supported at the
      moment.

endmenu # Processes and threads
```
